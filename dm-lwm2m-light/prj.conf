## Kconfig
```
# Copyright (c) 2017 Linaro Limited
#
# SPDX-License-Identifier: Apache-2.0
#

mainmenu "Linaro FOTA configuration"

config ZEPHYR_BASE
	string
	option env="ZEPHYR_BASE"

source "$ZEPHYR_BASE/Kconfig.zephyr"

config FOTA_DEVICE
	bool "Enable FOTA device settings"
	default y
	select FOTA_DEVICE_SOC_SERIES_KINETIS_K6X if SOC_SERIES_KINETIS_K6X
	select FOTA_DEVICE_SOC_SERIES_NRF52X if SOC_SERIES_NRF52X
	select FOTA_DEVICE_SOC_SERIES_STM32F4X if SOC_SERIES_STM32F4X
	help
	  Main config to enable device specific settings

config FOTA_DEVICE_SOC_SERIES_KINETIS_K6X
	bool "Kinetis K6x FOTA settings"
	select NET_L2_ETHERNET
	select NET_SHELL
	select NET_IPV4
	select NET_APP_NEED_IPV4
	default n

config FOTA_DEVICE_SOC_SERIES_NRF52X
	bool "Nordic Semiconductor nRF52 FOTA settings"
	select NET_L2_BT
	select NET_L2_BT_ZEP1656
	select NET_IPV6
	select NET_APP_NEED_IPV6
	select TEST_RANDOM_GENERATOR
	select PWM_NRF5_SW
	default n

config FOTA_DEVICE_SOC_SERIES_STM32F4X
	bool "STM32F4x FOTA settings"
	select NET_L2_BT
	select NET_L2_BT_ZEP1656
	select NET_IPV6
	select NET_APP_NEED_IPV6
	select TEST_RANDOM_GENERATOR
	select PWM_STM32
	default n

config SYS_LOG_FOTA_LEVEL
	int "FOTA log level"
	depends on SYS_LOG && FOTA_DEVICE
	default 0
	range 0 4
	help
	  Set the log level for the FOTA library.

	  The available levels are:

	  - 0 OFF: do not write
	  - 1 ERROR: only write SYS_LOG_ERR
	  - 2 WARNING: write SYS_LOG_WRN in addition to previous level
	  - 3 INFO: write SYS_LOG_INF in addition to previous levels
	  - 4 DEBUG: write SYS_LOG_DBG in addition to previous levels

# PWM Application Options

config APP_PWM_WHITE
	bool
	prompt "Enable dedicated PWM for white color"
	default y

if APP_PWM_WHITE

config APP_PWM_WHITE_DEV
	string
	prompt "PWM device name used for white"

config APP_PWM_WHITE_PIN
	int
	prompt "PWM pin number used for white"
	default 0

config APP_PWM_WHITE_PIN_CEILING
	int
	prompt "PWM pin level ceiling"
	default 255
	range 1 255

endif # APP_PWM_WHITE

config APP_PWM_RED
	bool
	prompt "Enable dedicated PWM for red"
	default n

if APP_PWM_RED

config APP_PWM_RED_DEV
	string
	prompt "PWM device name used for red"

config APP_PWM_RED_PIN
	int
	prompt "PWM pin number used for red"
	default 0

config APP_PWM_RED_PIN_CEILING
	int
	prompt "PWM pin level ceiling"
	default 255
	range 1 255

endif # APP_PWM_RED

config APP_PWM_GREEN
	bool
	prompt "Enable dedicated PWM for green"
	default n

if APP_PWM_GREEN

config APP_PWM_GREEN_DEV
	string
	prompt "PWM device name used for green"

config APP_PWM_GREEN_PIN
	int
	prompt "PWM pin number used for green"
	default 0

config APP_PWM_GREEN_PIN_CEILING
	int
	prompt "PWM pin level ceiling"
	default 255
	range 1 255

endif # APP_PWM_GREEN

config APP_PWM_BLUE
	bool
	prompt "Enable dedicated PWM for blue"
	default n

if APP_PWM_BLUE

config APP_PWM_BLUE_DEV
	string
	prompt "PWM device name used for blue"

config APP_PWM_BLUE_PIN
	int
	prompt "PWM pin number used for blue"
	default 0

config APP_PWM_BLUE_PIN_CEILING
	int
	prompt "PWM pin level ceiling"
	default 255
	range 1 255

endif # APP_PWM_BLUE
```

## prj.conf
```kconfig
CONFIG_BOOT_BANNER=y
CONFIG_BUILD_TIMESTAMP=y
CONFIG_REBOOT=y
CONFIG_FLASH=y
CONFIG_NETWORKING=y

# Leave device specific settings to enable IPV*
CONFIG_NET_IPV6=n
CONFIG_NET_IPV4=n

# Network
CONFIG_NET_UDP=y
CONFIG_NET_MGMT=y
CONFIG_NET_MGMT_EVENT=y
CONFIG_NET_CONTEXT_NET_PKT_POOL=y
CONFIG_NET_RX_STACK_SIZE=2048
CONFIG_NET_PKT_RX_COUNT=10
CONFIG_NET_PKT_TX_COUNT=10
CONFIG_NET_BUF_RX_COUNT=10
CONFIG_NET_BUF_TX_COUNT=10
CONFIG_NET_BUF_DATA_SIZE=384

# General
CONFIG_MINIMAL_LIBC_EXTENDED=y

# FOTA
CONFIG_FOTA_DEVICE=y

# APP
CONFIG_APP_PWM_WHITE=y
CONFIG_APP_PWM_RED=y
CONFIG_APP_PWM_GREEN=y
CONFIG_APP_PWM_BLUE=y

# NET APP
CONFIG_NET_APP=y
CONFIG_NET_APP_INIT_TIMEOUT=0
CONFIG_NET_APP_NEED_IPV6=n
CONFIG_NET_APP_NEED_IPV4=n
CONFIG_NET_APP_CLIENT=y
CONFIG_NET_APP_SETTINGS=y
CONFIG_NET_APP_BT_NODE=y
CONFIG_BT_DEVICE_NAME="Linaro IPSP node"

# COAP
CONFIG_COAP_EXTENDED_OPTIONS_LEN=y
CONFIG_COAP_EXTENDED_OPTIONS_LEN_VALUE=32

# PWM
CONFIG_PWM=y
#CONFIG_SYS_LOG_PWM_LEVEL=4

# LWM2M
CONFIG_LWM2M=y
CONFIG_LWM2M_RD_CLIENT_INSTANCE_COUNT=1
CONFIG_LWM2M_ENGINE_MAX_OBSERVER=20
CONFIG_LWM2M_SERVER_INSTANCE_COUNT=2
# CONFIG_LWM2M_RW_JSON_SUPPORT is not set
CONFIG_LWM2M_COAP_BLOCK_SIZE=256
CONFIG_LWM2M_FIRMWARE_UPDATE_PULL_COAP_PROXY_SUPPORT=y
CONFIG_LWM2M_IPSO_SUPPORT=y
CONFIG_LWM2M_IPSO_LIGHT_CONTROL=y
CONFIG_SYS_LOG_LWM2M_LEVEL=3

# Logging
CONFIG_SYS_LOG=y
CONFIG_SYS_LOG_SHOW_COLOR=y
CONFIG_SYS_LOG_EXT_HOOK=y
CONFIG_SYS_LOG_FOTA_LEVEL=4

# Bluetooth (when enabled) debug
#CONFIG_BT_DEBUG_LOG=y
#CONFIG_BT_DEBUG_HCI_DRIVER=y

# Add flash RW to MPU
CONFIG_MPU_ALLOW_FLASH_WRITE=y

# Debug helpers
#CONFIG_NET_LOG=y
#CONFIG_SYS_LOG_NET_LEVEL=4
#CONFIG_NET_DEBUG_CORE=y
#CONFIG_NET_DEBUG_NET_APP=y
#CONFIG_NET_DEBUG_IF=y
#CONFIG_NET_DEBUG_UTILS=y
#CONFIG_NET_DEBUG_CONTEXT=y
#CONFIG_NET_DEBUG_NET_PKT=y
#CONFIG_NET_DEBUG_NET_PKT_ALL=y
#CONFIG_NET_DEBUG_CONN=y
#CONFIG_NET_DEBUG_ROUTE=y
#CONFIG_NET_DEBUG_IPV4=y
#CONFIG_NET_DEBUG_IPV6=y
#CONFIG_NET_DEBUG_ICMPV6=y
#CONFIG_NET_DEBUG_IPV6_NBR_CACHE=y
#CONFIG_NET_DEBUG_6LO=y
#CONFIG_NET_DEBUG_UDP=y
#CONFIG_NET_DEBUG_L2_ETHERNET=y
#CONFIG_NET_DEBUG_L2_BT=y
#CONFIG_INIT_STACKS=y
#CONFIG_STACK_USAGE=y
```

## src/bluetooth.c
```c
/*
 * Copyright (c) 2016-2017 Linaro Limited
 *
 * SPDX-License-Identifier: Apache-2.0
 */

#define SYS_LOG_DOMAIN "fota/bluetooth"
#define SYS_LOG_LEVEL SYS_LOG_LEVEL_DEBUG
#include <logging/sys_log.h>

#include <zephyr/types.h>
#include <stddef.h>
#include <errno.h>
#include <zephyr.h>
#include <gpio.h>
#include <misc/reboot.h>
#include <init.h>
#include <soc.h>
#include <board.h>

#include <bluetooth/bluetooth.h>
#include <bluetooth/hci.h>
#include <bluetooth/storage.h>
#include <bluetooth/conn.h>

#include "product_id.h"

/* Any by default, can change depending on the hardware implementation */
static bt_addr_le_t bt_addr;

static ssize_t storage_read(const bt_addr_le_t *addr, u16_t key, void *data,
			       size_t length)
{
	if (addr) {
		return -ENOENT;
	}

	if (key == BT_STORAGE_ID_ADDR && length == sizeof(bt_addr)) {
		bt_addr_le_copy(data, &bt_addr);
		return sizeof(bt_addr);
	}

	return -EIO;
}

static ssize_t storage_write(const bt_addr_le_t *addr, u16_t key,
				const void *data, size_t length)
{
	return -ENOSYS;
}

static ssize_t storage_clear(const bt_addr_le_t *addr)
{
	return -ENOSYS;
}

static void set_own_bt_addr(void)
{
	int i;
	u8_t tmp;

	/*
	 * Generate a static BT addr using the unique product number.
	 */
	for (i = 0; i < 4; i++) {
		tmp = (product_id_get()->number >> i * 8) & 0xff;
		bt_addr.a.val[i] = tmp;
	}

	bt_addr.a.val[4] = 0xe7;
/*
 * For CONFIG_NET_L2_BT_ZEP1656, the U/L bit of the BT MAC is toggled by Zephyr.
 * Later that MAC is used to create the 6LOWPAN IPv6 address.  To account for
 * that, we set 0xd6 here which toggles to 0xd4 later (matching the Linux
 * gateway configuration for bt0).
 */
#if defined(CONFIG_NET_L2_BT_ZEP1656)
	bt_addr.a.val[5] = 0xd6;
#else
	bt_addr.a.val[5] = 0xd4;
#endif
}

static int bt_storage_init(void)
{
	static const struct bt_storage storage = {
		.read = storage_read,
		.write = storage_write,
		.clear = storage_clear,
	};

	bt_addr.type = BT_ADDR_LE_RANDOM;

	set_own_bt_addr();

	bt_storage_register(&storage);

	SYS_LOG_DBG("Bluetooth storage driver registered");

	return 0;
}

/* BT LE Connect/Disconnect callbacks */
static void set_bluetooth_led(bool state)
{
#if defined(BT_GPIO_PIN) && defined(BT_GPIO_PORT)
	struct device *gpio = device_get_binding(BT_GPIO_PORT);
	gpio_pin_configure(gpio, BT_GPIO_PIN, GPIO_DIR_OUT);
	gpio_pin_write(gpio, BT_GPIO_PIN, state);
#elif defined(LED0_GPIO_PIN) && defined(LED0_GPIO_PORT)
	/* Use LED0 in case there is no dedicated LED for BT */
	struct device *gpio = device_get_binding(LED0_GPIO_PORT);
	gpio_pin_configure(gpio, LED0_GPIO_PIN, GPIO_DIR_OUT);
	gpio_pin_write(gpio, LED0_GPIO_PIN, state);
#endif
}

static void connected(struct bt_conn *conn, u8_t err)
{
	if (err) {
		SYS_LOG_ERR("BT LE Connection failed: %u", err);
	} else {
		SYS_LOG_INF("BT LE Connected");
		set_bluetooth_led(1);
	}
}

static void disconnected(struct bt_conn *conn, u8_t reason)
{
	SYS_LOG_ERR("BT LE Disconnected (reason %u), rebooting!", reason);
	set_bluetooth_led(0);
	sys_reboot(0);
}

static struct bt_conn_cb conn_callbacks = {
	.connected = connected,
	.disconnected = disconnected,
};

static int bt_network_init(struct device *dev)
{
	/* Storage used to provide a BT MAC based on the serial number */
	SYS_LOG_DBG("Setting Bluetooth MAC\n");
	bt_storage_init();
	bt_conn_cb_register(&conn_callbacks);
	return 0;
}

/* last priority in the POST_KERNEL init levels */
SYS_INIT(bt_network_init, APPLICATION, CONFIG_APPLICATION_INIT_PRIORITY);
```
